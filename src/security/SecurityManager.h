#pragma once
// Three related but distinct concerns, per spec sections 12 and 35:
//  1) Web admin session lifecycle (8 min inactivity timeout -> WEB LOCKED).
//  2) The one-time 6-digit security code generated by holding BUTTON 1
//     while the web session is locked, valid ~1s, single use.
//  3) Rolling failed-attempt counting (RFID denials, bad security codes,
//     bad web logins) feeding a WARNING/TAMPER threshold (spec 54).
// Session tokens are opaque random strings, not JWTs — this device has no
// need for stateless auth across restarts; a reboot simply invalidates all
// sessions, which is the safe default for a physical lockbox controller.
#include <Arduino.h>
#include <map>
#include "../core/EventBus.h"
#include "../config/ConfigManager.h"
#include "../events/EventLogger.h"

struct WebSession {
  String token;
  String userId;
  uint32_t lastActivityMs = 0;
};

class SecurityManager {
 public:
  static SecurityManager& instance() {
    static SecurityManager m;
    return m;
  }

  void begin() {
    EventBus::instance().on(Topic::RfidDenied, [this](const EventPayload&) { onFailure(); });
  }

  void loop() {
    // Expire the pending one-shot security code.
    if (codeActive_ && millis() > codeExpiresAtMs_) {
      codeActive_ = false;
      EventLogger::instance().log(EventType::SECURITY_CODE_EXPIRED, EventSource::SYSTEM);
      EventBus::instance().emit(Topic::SecurityCodeExpired);
    }
    // Expire idle web sessions.
    uint32_t timeoutMs = (uint32_t)ConfigManager::instance().get().security.sessionTimeoutSec * 1000UL;
    for (auto it = sessions_.begin(); it != sessions_.end();) {
      if (millis() - it->second.lastActivityMs > timeoutMs) {
        EventLogger::instance().log(EventType::WEB_LOCKED, EventSource::WEB, it->second.userId);
        EventBus::instance().emit(Topic::WebSessionLocked, EventPayload(it->second.userId));
        it = sessions_.erase(it);
      } else {
        ++it;
      }
    }
  }

  // ---- Web sessions ----
  String createSession(const String& userId) {
    String token = randomToken();
    sessions_[token] = WebSession{token, userId, millis()};
    EventLogger::instance().log(EventType::ADMIN_LOGIN, EventSource::WEB, userId);
    EventBus::instance().emit(Topic::AdminLogin, EventPayload(userId));
    return token;
  }

  bool touchSession(const String& token) {
    auto it = sessions_.find(token);
    if (it == sessions_.end()) return false;
    it->second.lastActivityMs = millis();
    return true;
  }

  WebSession* getSession(const String& token) {
    auto it = sessions_.find(token);
    return it == sessions_.end() ? nullptr : &it->second;
  }

  void endSession(const String& token) {
    auto it = sessions_.find(token);
    if (it == sessions_.end()) return;
    EventLogger::instance().log(EventType::ADMIN_LOGOUT, EventSource::WEB, it->second.userId);
    EventBus::instance().emit(Topic::AdminLogout, EventPayload(it->second.userId));
    sessions_.erase(it);
  }

  // ---- One-time security code (spec section 12) ----
  // Generates a 6-digit code, valid for SecurityConfig::securityCodeTtlMs
  // (default ~1000ms per spec), usable exactly once. Triggered by holding
  // BUTTON 1 while the web UI shows "WEB LOCKED / HOLD BUTTON 1".
  String generateSecurityCode() {
    int code = esp_random() % 1000000;
    char buf[8]; snprintf(buf, sizeof(buf), "%06d", code);
    lastCode_ = buf;
    codeActive_ = true;
    codeExpiresAtMs_ = millis() + (uint32_t)ConfigManager::instance().get().security.securityCodeTtlMs;
    EventLogger::instance().log(EventType::SECURITY_CODE_CREATED, EventSource::LOCAL);
    EventBus::instance().emit(Topic::SecurityCodeCreated);
    return lastCode_;
  }

  // Returns true and consumes the code if it matches and hasn't expired.
  bool tryConsumeSecurityCode(const String& attempt) {
    if (!codeActive_ || millis() > codeExpiresAtMs_) return false;
    bool ok = (attempt == lastCode_);
    if (ok) {
      codeActive_ = false;
      EventLogger::instance().log(EventType::SECURITY_CODE_USED, EventSource::WEB);
      EventBus::instance().emit(Topic::SecurityCodeUsed);
    } else {
      onFailure();
    }
    return ok;
  }

  // ---- Rate limiting / tamper threshold ----
  void onFailure() {
    failureCount_++;
    int max = ConfigManager::instance().get().security.maxFailedAttempts;
    if (max > 0 && failureCount_ >= (uint32_t)max) {
      failureCount_ = 0;
      EventBus::instance().emit(Topic::TamperDetected, EventPayload("failed_attempts_threshold"));
    }
  }
  void resetFailures() { failureCount_ = 0; }

  int accessDeniedDelayMs() const {
    return ConfigManager::instance().get().security.accessDeniedDelayMs;
  }

 private:
  SecurityManager() = default;
  std::map<String, WebSession> sessions_;
  String lastCode_;
  bool codeActive_ = false;
  uint32_t codeExpiresAtMs_ = 0;
  uint32_t failureCount_ = 0;

  String randomToken() {
    String t;
    for (int i = 0; i < 24; i++) {
      uint8_t v = esp_random() % 36;
      t += (char)(v < 10 ? ('0' + v) : ('a' + v - 10));
    }
    return t;
  }
};
